

#include "ranger_can.h"
#include "ace_light.h"
#include "ranger_param.h"

#include "main.h"



/*
 * FDCAN1 handle is defined by CubeMX in main.c.
 */
extern FDCAN_HandleTypeDef hfdcan1;

/*
 * AceLight protocol instance used by the Ranger.
 *
 * The instance stores:
 *
 *   - Pointer to the Ranger parameter dictionary
 *   - Number of entries in the dictionary
 *   - CAN transmit callback
 */
static ace_light_t g_ace;


/**
 * @brief Initialize the Ranger CAN interface and AceLight protocol engine.
 *
 * The STM32 FDCAN peripheral is configured to receive extended CAN
 * frames into RX FIFO0.
 *
 * AceLight itself performs the protocol-level filtering, including
 * destination Node ID checks.
 *
 * @return true if initialization succeeded.
 */
bool ranger_can_init(void)
{
    FDCAN_FilterTypeDef filter = {0};

    /*
     * Accept all extended CAN identifiers into RX FIFO0.
     *
     * FilterID2 is the mask. A mask value of zero means that no
     * identifier bits are compared, so every extended identifier
     * matches this filter.
     *
     * AceLight will determine whether the received frame belongs
     * to this node.
     */
    filter.IdType       = FDCAN_EXTENDED_ID;
    filter.FilterIndex  = 0U;
    filter.FilterType   = FDCAN_FILTER_MASK;
    filter.FilterConfig = FDCAN_FILTER_TO_RXFIFO0;
    filter.FilterID1    = 0U;
    filter.FilterID2    = 0U;

    if (HAL_FDCAN_ConfigFilter(
            &hfdcan1,
            &filter) != HAL_OK)
    {
        return false;
    }

    /*
     * Reject frames which are not accepted by an explicit filter.
     *
     * Standard CAN identifiers are therefore rejected.
     *
     * Extended identifiers are accepted by Filter 0 above.
     */
    if (HAL_FDCAN_ConfigGlobalFilter(
            &hfdcan1,
            FDCAN_REJECT,
            FDCAN_REJECT,
            FDCAN_REJECT_REMOTE,
            FDCAN_REJECT_REMOTE) != HAL_OK)
    {
        return false;
    }

    /*
     * Start the FDCAN peripheral.
     */
    if (HAL_FDCAN_Start(&hfdcan1) != HAL_OK)
    {
        return false;
    }

    /*
     * Enable the RX FIFO0 new-message interrupt.
     */
    if (HAL_FDCAN_ActivateNotification(
            &hfdcan1,
            FDCAN_IT_RX_FIFO0_NEW_MESSAGE,
            0U) != HAL_OK)
    {
        return false;
    }

    /*
     * Connect the Ranger parameter dictionary and CAN transmit
     * function to the generic AceLight protocol engine.
     */
    ace_init(
        &g_ace,
        ranger_param_table,
        ranger_param_count,
        ranger_can_transmit);

    return true;
}


/**
 * @brief Transmit a CAN frame generated by AceLight.
 *
 * This function is supplied to AceLight as its hardware-specific
 * transmit callback.
 *
 * @param identifier Extended 29-bit CAN identifier.
 * @param data       Payload data.
 * @param length     Payload length in bytes.
 *
 * @return true if the frame was successfully queued for transmission.
 */
bool ranger_can_transmit(
    uint32_t identifier,
    const uint8_t *data,
    uint8_t length)
{
    FDCAN_TxHeaderTypeDef tx_header = {0};

    /*
     * Current AceLight implementation uses classical CAN payload sizes.
     */
    if (length > 8U)
    {
        return false;
    }

    switch (length)
    {
        case 0U:
            tx_header.DataLength = FDCAN_DLC_BYTES_0;
            break;

        case 1U:
            tx_header.DataLength = FDCAN_DLC_BYTES_1;
            break;

        case 2U:
            tx_header.DataLength = FDCAN_DLC_BYTES_2;
            break;

        case 3U:
            tx_header.DataLength = FDCAN_DLC_BYTES_3;
            break;

        case 4U:
            tx_header.DataLength = FDCAN_DLC_BYTES_4;
            break;

        case 5U:
            tx_header.DataLength = FDCAN_DLC_BYTES_5;
            break;

        case 6U:
            tx_header.DataLength = FDCAN_DLC_BYTES_6;
            break;

        case 7U:
            tx_header.DataLength = FDCAN_DLC_BYTES_7;
            break;

        case 8U:
            tx_header.DataLength = FDCAN_DLC_BYTES_8;
            break;

        default:
            return false;
    }

    /*
     * Configure the STM32 FDCAN transmit header.
     */
    tx_header.Identifier          = identifier;
    tx_header.IdType              = FDCAN_EXTENDED_ID;
    tx_header.TxFrameType         = FDCAN_DATA_FRAME;
    //tx_header.DataLength          = ((uint32_t)length << 16U);
    tx_header.ErrorStateIndicator = FDCAN_ESI_ACTIVE;
    tx_header.BitRateSwitch       = FDCAN_BRS_OFF;
    tx_header.FDFormat            = FDCAN_CLASSIC_CAN;
    tx_header.TxEventFifoControl  = FDCAN_NO_TX_EVENTS;
    tx_header.MessageMarker       = 0U;

    /*
     * Queue the frame for transmission.
     */
    return (HAL_FDCAN_AddMessageToTxFifoQ(
                &hfdcan1,
                &tx_header,
                (uint8_t *)data) == HAL_OK);
}


/**
 * @brief STM32 HAL callback for received FIFO0 CAN frames.
 *
 * Received frames are passed directly to the generic AceLight
 * protocol engine.
 */
void HAL_FDCAN_RxFifo0Callback(
    FDCAN_HandleTypeDef *hfdcan,
    uint32_t RxFifo0ITs)
{
    FDCAN_RxHeaderTypeDef rx_header;
    uint8_t rx_data[8];

    /*
     * Ignore callbacks from another FDCAN peripheral.
     */
    if (hfdcan != &hfdcan1)
    {
        return;
    }

    /*
     * Only process new-message notifications.
     */
    if ((RxFifo0ITs & FDCAN_IT_RX_FIFO0_NEW_MESSAGE) == 0U)
    {
        return;
    }

    /*
     * Drain all currently queued frames from RX FIFO0.
     */
    while (HAL_FDCAN_GetRxFifoFillLevel(
               hfdcan,
               FDCAN_RX_FIFO0) > 0U)
    {
        if (HAL_FDCAN_GetRxMessage(
                hfdcan,
                FDCAN_RX_FIFO0,
                &rx_header,
                rx_data) != HAL_OK)
        {
            return;
        }

        uint8_t length;

        switch (rx_header.DataLength)
        {
            case FDCAN_DLC_BYTES_0: length = 0U; break;
            case FDCAN_DLC_BYTES_1: length = 1U; break;
            case FDCAN_DLC_BYTES_2: length = 2U; break;
            case FDCAN_DLC_BYTES_3: length = 3U; break;
            case FDCAN_DLC_BYTES_4: length = 4U; break;
            case FDCAN_DLC_BYTES_5: length = 5U; break;
            case FDCAN_DLC_BYTES_6: length = 6U; break;
            case FDCAN_DLC_BYTES_7: length = 7U; break;
            case FDCAN_DLC_BYTES_8: length = 8U; break;

            default:
                return;
        }

        /*
         * Forward the raw CAN frame to AceLight.
         *
         * AceLight handles:
         *
         *   - Identifier decoding
         *   - Destination checking
         *   - Message routing
         *   - Parameter access
         *   - Response generation
         */
        ace_receive(
            &g_ace,
            rx_header.Identifier,
            rx_data,
			length);
    }
}
